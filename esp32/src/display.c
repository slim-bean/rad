#include <string.h>
#include "driver/gpio.h"
#include "driver/ledc.h"
#include "driver/spi_master.h"
#include "esp_check.h"
#include "esp_lcd_panel_io.h"
#include "esp_lcd_panel_ops.h"
#include "esp_lcd_panel_vendor.h"
#include "esp_log.h"
#include "pins.h"
#include "display.h"

static const char *TAG = "display";

#define BL_TIMER      LEDC_TIMER_1
#define BL_CHANNEL    LEDC_CHANNEL_1
#define BL_FREQ_HZ    25000
#define BL_RESOLUTION LEDC_TIMER_10_BIT
#define BL_DUTY_MAX   1023
#define BL_DUTY_PCT   40

/* ------------------------------------------------------------------ */
/*  8×8 bitmap font — printable ASCII 0x20–0x7E, MSB = leftmost pixel */
/* ------------------------------------------------------------------ */
static const uint8_t font8x8[][8] = {
    {0x00,0x00,0x00,0x00,0x00,0x00,0x00,0x00}, /* 0x20   */
    {0x18,0x3C,0x3C,0x18,0x18,0x00,0x18,0x00}, /* 0x21 ! */
    {0x6C,0x6C,0x24,0x00,0x00,0x00,0x00,0x00}, /* 0x22 " */
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    {0x76,0xDC,0x00,0x00,0x00,0x00,0x00,0x00}, /* 0x7E ~ */
};

#define FONT_FIRST  0x20
#define FONT_W      8
#define FONT_H      8

/* ------------------------------------------------------------------ */
/*  7-segment digit geometry (unscaled: 28 w × 48 h)                  */
/* ------------------------------------------------------------------ */
/*  Segments:  bit 0=A(top), 1=B(upper-right), 2=C(lower-right),
 *             3=D(bottom), 4=E(lower-left), 5=F(upper-left), 6=G(mid) */
static const uint8_t seg_table[10] = {
    0x3F, 0x06, 0x5B, 0x4F, 0x66,
    0x6D, 0x7D, 0x07, 0x7F, 0x6F,
};

/* Segment rectangles (x, y, w, h) for a 28×48 cell */
typedef struct { int8_t x, y, w, h; } seg_rect_t;
static const seg_rect_t seg_rects[7] = {
    { 4,  0, 20,  4},   /* A — top        */
    {24,  4,  4, 18},   /* B — upper right */
    {24, 26,  4, 18},   /* C — lower right */
    { 4, 44, 20,  4},   /* D — bottom      */
    { 0, 26,  4, 18},   /* E — lower left  */
    { 0,  4,  4, 18},   /* F — upper left  */
    { 4, 22, 20,  4},   /* G — middle      */
};

/* ------------------------------------------------------------------ */
/*  LCD panel handle                                                   */
/* ------------------------------------------------------------------ */
static esp_lcd_panel_handle_t panel;

#define LINE_BUF_W  320
static uint16_t line_buf[LINE_BUF_W];


void display_init(void)
{
    ledc_timer_config_t bl_timer = {
        .speed_mode      = LEDC_LOW_SPEED_MODE,
        .timer_num       = BL_TIMER,
        .duty_resolution = BL_RESOLUTION,
        .freq_hz         = BL_FREQ_HZ,
        .clk_cfg         = LEDC_AUTO_CLK,
    };
    ESP_ERROR_CHECK(ledc_timer_config(&bl_timer));

    ledc_channel_config_t bl_chan = {
        .speed_mode = LEDC_LOW_SPEED_MODE,
        .channel    = BL_CHANNEL,
        .timer_sel  = BL_TIMER,
        .gpio_num   = PIN_TFT_BL,
        .duty       = (BL_DUTY_MAX * BL_DUTY_PCT) / 100,
        .hpoint     = 0,
    };
    ESP_ERROR_CHECK(ledc_channel_config(&bl_chan));
    ESP_LOGI(TAG, "Backlight PWM %d%% @ %d Hz (GPIO %d)", BL_DUTY_PCT, BL_FREQ_HZ, PIN_TFT_BL);

    spi_bus_config_t bus = {
        .sclk_io_num     = PIN_TFT_SCLK,
        .mosi_io_num     = PIN_TFT_MOSI,
        .miso_io_num     = -1,
        .quadwp_io_num   = -1,
        .quadhd_io_num   = -1,
        .max_transfer_sz = TFT_WIDTH * 40 * sizeof(uint16_t),
    };
    ESP_ERROR_CHECK(spi_bus_initialize(TFT_SPI_HOST, &bus, SPI_DMA_CH_AUTO));
    ESP_LOGI(TAG, "SPI bus initialised (host %d)", TFT_SPI_HOST);

    esp_lcd_panel_io_handle_t io;
    esp_lcd_panel_io_spi_config_t io_cfg = {
        .dc_gpio_num       = PIN_TFT_DC,
        .cs_gpio_num       = PIN_TFT_CS,
        .pclk_hz           = TFT_SPI_FREQ_HZ,
        .lcd_cmd_bits      = 8,
        .lcd_param_bits    = 8,
        .spi_mode          = 0,
        .trans_queue_depth  = 10,
    };
    ESP_ERROR_CHECK(esp_lcd_new_panel_io_spi((esp_lcd_spi_bus_handle_t)TFT_SPI_HOST, &io_cfg, &io));
    ESP_LOGI(TAG, "Panel IO created (DC=%d CS=%d)", PIN_TFT_DC, PIN_TFT_CS);

    esp_lcd_panel_dev_config_t panel_cfg = {
        .reset_gpio_num = PIN_TFT_RST,
        .rgb_endian     = LCD_RGB_ENDIAN_BGR,
        .bits_per_pixel = 16,
    };
    ESP_ERROR_CHECK(esp_lcd_new_panel_st7789(io, &panel_cfg, &panel));
    ESP_LOGI(TAG, "ST7789 panel created (RST=%d)", PIN_TFT_RST);

    ESP_ERROR_CHECK(esp_lcd_panel_reset(panel));
    ESP_ERROR_CHECK(esp_lcd_panel_init(panel));
    ESP_ERROR_CHECK(esp_lcd_panel_invert_color(panel, true));
    ESP_ERROR_CHECK(esp_lcd_panel_swap_xy(panel, true));
    ESP_ERROR_CHECK(esp_lcd_panel_mirror(panel, false, true));
    ESP_ERROR_CHECK(esp_lcd_panel_disp_on_off(panel, true));

    ESP_LOGI(TAG, "Panel configured — display ON");

    display_fill_rect(0, 0, TFT_WIDTH, TFT_HEIGHT, COL_BLACK);
    ESP_LOGI(TAG, "Init complete (%dx%d)", TFT_WIDTH, TFT_HEIGHT);
}


void display_backlight(bool on)
{
    uint32_t duty = on ? (BL_DUTY_MAX * BL_DUTY_PCT) / 100 : 0;
    ledc_set_duty(LEDC_LOW_SPEED_MODE, BL_CHANNEL, duty);
    ledc_update_duty(LEDC_LOW_SPEED_MODE, BL_CHANNEL);
}


void display_fill_rect(int x, int y, int w, int h, uint16_t color)
{
    int cw = (w > LINE_BUF_W) ? LINE_BUF_W : w;
    for (int i = 0; i < cw; i++)
        line_buf[i] = color;

    for (int row = y; row < y + h; row++)
        esp_lcd_panel_draw_bitmap(panel, x, row, x + cw, row + 1, line_buf);
}


void display_draw_char(int x, int y, char c, uint16_t fg, uint16_t bg, int scale)
{
    if (c < FONT_FIRST || c > 0x7E)
        c = ' ';
    const uint8_t *glyph = font8x8[c - FONT_FIRST];

    int pw = FONT_W * scale;
    uint16_t row_buf[FONT_W * 4];  /* max scale=4 → 32 pixels wide */

    for (int gy = 0; gy < FONT_H; gy++) {
        uint8_t bits = glyph[gy];
        for (int gx = 0; gx < FONT_W; gx++) {
            uint16_t col = (bits & 0x80) ? fg : bg;
            for (int sx = 0; sx < scale; sx++)
                row_buf[gx * scale + sx] = col;
            bits <<= 1;
        }
        for (int sy = 0; sy < scale; sy++)
            esp_lcd_panel_draw_bitmap(panel, x, y + gy * scale + sy,
                                      x + pw, y + gy * scale + sy + 1,
                                      row_buf);
    }
}


void display_draw_string(int x, int y, const char *s, uint16_t fg, uint16_t bg, int scale)
{
    while (*s) {
        display_draw_char(x, y, *s, fg, bg, scale);
        x += FONT_W * scale;
        s++;
    }
}


void display_draw_7seg(int x, int y, int digit, uint16_t fg, uint16_t bg, int scale)
{
    uint8_t segs = (digit >= 0 && digit <= 9) ? seg_table[digit] : 0x00;

    /* Clear the cell background */
    display_fill_rect(x, y, 28 * scale, 48 * scale, bg);

    for (int s = 0; s < 7; s++) {
        if (segs & (1 << s)) {
            const seg_rect_t *r = &seg_rects[s];
            display_fill_rect(x + r->x * scale, y + r->y * scale,
                              r->w * scale, r->h * scale, fg);
        }
    }
}
